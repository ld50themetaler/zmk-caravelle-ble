#include <dt-bindings/zmk/matrix_transform.h>
#include "caravelle.dtsi"

/ {
    // Left-hand specific kscan (overrides shared definition)
    kscan_left: kscan0 {
        compatible = "zmk,kscan-gpio-matrix";
        label = "KSCAN_LEFT";
        diode-direction = "row2col";
        wakeup-source;

        /* Row Pin: original left mapping (P0.0) */
        row-gpios = <&gpio0 0 (GPIO_ACTIVE_LOW)>;

        /* Col Pins: original mapping for left-hand */
        col-gpios
            = <&gpio0 16 (GPIO_ACTIVE_LOW | GPIO_PULL_UP)>
            , <&gpio0 11 (GPIO_ACTIVE_LOW | GPIO_PULL_UP)>
            , <&gpio0 6  (GPIO_ACTIVE_LOW | GPIO_PULL_UP)>
            , <&gpio0 3  (GPIO_ACTIVE_LOW | GPIO_PULL_UP)>
            , <&gpio0 15 (GPIO_ACTIVE_LOW | GPIO_PULL_UP)>
            , <&gpio0 31 (GPIO_ACTIVE_LOW | GPIO_PULL_UP)>
            , <&gpio0 18 (GPIO_ACTIVE_LOW | GPIO_PULL_UP)>
            , <&gpio0 12 (GPIO_ACTIVE_LOW | GPIO_PULL_UP)>
            , <&gpio0 7  (GPIO_ACTIVE_LOW | GPIO_PULL_UP)>
            , <&gpio0 4  (GPIO_ACTIVE_LOW | GPIO_PULL_UP)>
            , <&gpio0 13 (GPIO_ACTIVE_LOW | GPIO_PULL_UP)>
            , <&gpio0 19 (GPIO_ACTIVE_LOW | GPIO_PULL_UP)>
            , <&gpio0 30 (GPIO_ACTIVE_LOW | GPIO_PULL_UP)>
            , <&gpio0 20 (GPIO_ACTIVE_LOW | GPIO_PULL_UP)>
            , <&gpio0 14 (GPIO_ACTIVE_LOW | GPIO_PULL_UP)>
            , <&gpio0 8  (GPIO_ACTIVE_LOW | GPIO_PULL_UP)>
            , <&gpio0 5  (GPIO_ACTIVE_LOW | GPIO_PULL_UP)>
            , <&gpio0 2  (GPIO_ACTIVE_LOW | GPIO_PULL_UP)>
            , <&gpio0 17 (GPIO_ACTIVE_LOW | GPIO_PULL_UP)>
            , <&gpio0 29 (GPIO_ACTIVE_LOW | GPIO_PULL_UP)>
            , <&gpio0 28 (GPIO_ACTIVE_LOW | GPIO_PULL_UP)>
            , <&gpio0 27 (GPIO_ACTIVE_LOW | GPIO_PULL_UP)>
            , <&gpio0 26 (GPIO_ACTIVE_LOW | GPIO_PULL_UP)>
            , <&gpio0 25 (GPIO_ACTIVE_LOW | GPIO_PULL_UP)>;
    };
};

&physical_layout0 {
    kscan = <&kscan_left>;
    transform = <&default_transform>;
};