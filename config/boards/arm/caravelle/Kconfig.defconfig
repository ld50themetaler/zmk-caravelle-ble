## config/boards/arm/caravelle/Kconfig.defconfig
```kconfig
# Caravelle BLE board configuration

if BOARD_CARAVELLE

config BOARD
	default "caravelle"

config BT_CTLR
	default BT

endif # BOARD_CARAVELLE
```

## modules/zmk-behavior-nordic-dfu/Kconfig
```kconfig
config ZMK_BEHAVIOR_NORDIC_DFU
	bool "Nordic Secure DFU behavior"
	default y
	help
	  Enable Nordic Secure DFU behavior to reboot into DfuTarg.
```

## modules/zmk-behavior-nordic-dfu/dts/bindings/behaviors/zmk,behavior-nordic-dfu.yaml
```yaml
# Copyright (c) 2026 The ZMK Contributors
# SPDX-License-Identifier: MIT

description: Nordic Secure DFU behavior

compatible: zmk,behavior-nordic-dfu

include: zero_param.yaml
```
