## config/boards/arm/caravelle/board.yml
```yaml
board:
  name: caravelle
  vendor: zmk-contributors
  socs:
    - name: nrf52832
```

## config/boards/caravelle/Kconfig
```kconfig
# Caravelle BLE board configuration

config BOARD_CARAVELLE
	bool "Caravelle BLE"
	select SOC_NRF52832_QFAA

if BOARD_CARAVELLE

config BOARD
	default "caravelle"

endif # BOARD_CARAVELLE
```

## config/boards/caravelle/Kconfig.board
```kconfig
# Caravelle BLE board configuration

config BOARD_CARAVELLE
	bool "Caravelle BLE"
	select SOC_NRF52832_QFAA
```

## config/boards/caravelle/Kconfig.defconfig
```kconfig
# Caravelle BLE board configuration

if BOARD_CARAVELLE

config BOARD
	default "caravelle"



endif # BOARD_CARAVELLE
```

## config/boards/shields/caravelle/Kconfig.defconfig
```kconfig
if SHIELD_CARAVELLE_LEFT || SHIELD_CARAVELLE_RIGHT

config ZMK_SPLIT
    default y

endif

if SHIELD_CARAVELLE_LEFT

config ZMK_SPLIT_ROLE_CENTRAL
    default y

endif

if SHIELD_CARAVELLE_RIGHT

config ZMK_SPLIT_ROLE_CENTRAL
    default n
endif
```

## config/boards/shields/caravelle/Kconfig.shield
```kconfig
config SHIELD_CARAVELLE_LEFT
    def_bool $(shields_list_contains,caravelle_left)

config SHIELD_CARAVELLE_RIGHT
    def_bool $(shields_list_contains,caravelle_right)
```

## config/west.yml
```yaml
manifest:
  version: "0.13"
  
  # ZMK リポジトリのマニフェストを継承
  # (ZMK v0.3 は Zephyr 3.5 を使用、main は Zephyr 4.1 を使用)
  self:
    path: config

  # ローカルプロジェクト（このリポジトリ）
  projects:
    # ZMK ファームウェアの main ブランチを使用
    - name: zmk
      remote: zmkfirmware
      revision: main
      import: app/west.yml

  # リモートリポジトリの定義
  remotes:
    - name: zmkfirmware
      url-base: https://github.com/zmkfirmware
```
